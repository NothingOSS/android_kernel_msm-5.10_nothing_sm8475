/dts-v1/;

#include "ravelinp.dtsi"
#include "ravelinp-idp.dtsi"

/ {
	model = "Qualcomm Technologies, Inc. RavelinP IDP";
	compatible = "qcom,ravelinp-idp", "qcom,ravelinp", "qcom,idp";
	qcom,board-id = <34 0>;
};
