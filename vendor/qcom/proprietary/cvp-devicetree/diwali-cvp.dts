/dts-v1/;
/plugin/;

#include <dt-bindings/interrupt-controller/arm-gic.h>
#include <dt-bindings/soc/qcom,ipcc.h>
#include <dt-bindings/interconnect/qcom,diwali.h>
#include <dt-bindings/clock/qcom,videocc-diwali.h>
#include <dt-bindings/clock/qcom,gcc-diwali.h>
#include "diwali-cvp.dtsi"

/ {
	model = "Qualcomm Technologies, Inc. diwali SoC";
	compatible = "qcom,diwali";
	qcom,msm-id = <506 0x10000>, <547 0x10000>, <564 0x10000>;
	qcom,board-id = <0 0>, <0 2>;
};