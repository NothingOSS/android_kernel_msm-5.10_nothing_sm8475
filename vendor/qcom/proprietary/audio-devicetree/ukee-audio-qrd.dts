/dts-v1/;
/plugin/;

#include "ukee-audio-qrd.dtsi"

/ {
	model = "Qualcomm Technologies, Inc. Ukee QRD";
	compatible = "qcom,ukee-qrd", "qcom,ukee", "qcom,qrd";
	qcom,msm-id = <591 0x10000>;
	qcom,board-id = <0x1000B 0>;
};
