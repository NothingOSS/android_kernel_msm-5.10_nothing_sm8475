/dts-v1/;
/plugin/;

#include "parrot-audio-idp.dtsi"

/ {
	model = "Qualcomm Technologies, Inc. Parrot WCN6755 IDP PLUS";
	compatible = "qcom,parrot-idp", "qcom,parrot", "qcom,idp";
	qcom,msm-id = <537 0x10000>, <613 0x10000>, <663 0x10000>;
	qcom,board-id = <34 5>;
};

