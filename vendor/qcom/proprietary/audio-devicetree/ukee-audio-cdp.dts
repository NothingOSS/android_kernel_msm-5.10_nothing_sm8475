/dts-v1/;
/plugin/;

#include "ukee-audio-cdp.dtsi"

/ {
	model = "Qualcomm Technologies, Inc. Ukee CDP";
	compatible = "qcom,ukee-cdp", "qcom,ukee", "qcom,cdp";
	qcom,msm-id = <591 0x10000>;
	qcom,board-id = <0x10001 0>;
};
