/dts-v1/;
/plugin/;

#include "ravelin-audio-idp.dtsi"

/ {
    model = "Qualcomm Technologies, Inc. Ravelin IDP WCD with HAC";
    compatible = "qcom,ravelin-idp", "qcom,ravelin", "qcom,idp";
    qcom,msm-id = <568 0x10000>, <602 0x10000>, <581 0x10000>, <582 0x10000>;
    qcom,board-id = <34 6>;
};

