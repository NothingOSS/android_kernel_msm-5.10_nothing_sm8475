/dts-v1/;
/plugin/;

#include "parrot-audio-qrd.dtsi"

/ {
	model = "Qualcomm Technologies, Inc. Parrot WCN6750 QRD PLUS";
	compatible = "qcom,parrot-qrd", "qcom,parrot", "qcom,qrd";
	qcom,msm-id = <537 0x10000>, <613 0x10000>, <663 0x10000>;
	qcom,board-id = <0x1000B 2>;
};
