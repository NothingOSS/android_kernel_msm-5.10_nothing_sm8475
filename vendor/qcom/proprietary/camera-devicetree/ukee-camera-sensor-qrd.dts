/dts-v1/;
/plugin/;

#include <dt-bindings/clock/qcom,gcc-waipio.h>
#include <dt-bindings/clock/qcom,camcc-waipio.h>
#include <dt-bindings/interconnect/qcom,waipio.h>
#include <dt-bindings/interrupt-controller/arm-gic.h>
#include <dt-bindings/regulator/qcom,rpmh-regulator-levels.h>

#include "ukee-camera-sensor-qrd.dtsi"
/ {
	model = "Qualcomm Technologies, Inc. Ukee QRD";
	compatible = "qcom,ukee-qrd", "qcom,ukee", "qcom,qrd";
	qcom,msm-id = <591 0x10000>;
	qcom,board-id = <0x1000B 0>;
};
