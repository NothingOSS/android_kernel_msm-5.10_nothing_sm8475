/dts-v1/;
/plugin/;

#include <dt-bindings/clock/qcom,gcc-ravelin.h>
#include <dt-bindings/clock/qcom,camcc-ravelin.h>
#include <dt-bindings/interconnect/qcom,ravelin.h>
#include <dt-bindings/interrupt-controller/arm-gic.h>
#include <dt-bindings/regulator/qcom,rpmh-regulator-levels.h>

#include "raveline-camera-sensor-qrd.dtsi"
/ {
	model = "Qualcomm Technologies, Inc. Raveline QRD";
	compatible = "qcom,raveline";
	qcom,msm-id = <568 0x10000>;
	qcom,board-id = <0x1000B 0>, <0x1000B 1>;
};