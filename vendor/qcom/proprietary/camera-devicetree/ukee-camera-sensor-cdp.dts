/dts-v1/;
/plugin/;

#include <dt-bindings/clock/qcom,gcc-waipio.h>
#include <dt-bindings/clock/qcom,camcc-waipio.h>
#include <dt-bindings/interconnect/qcom,waipio.h>
#include <dt-bindings/interrupt-controller/arm-gic.h>
#include <dt-bindings/regulator/qcom,rpmh-regulator-levels.h>

#include "ukee-camera-sensor-cdp.dtsi"
/ {
	model = "Qualcomm Technologies, Inc. Ukee CDP";
	compatible = "qcom,ukee-cdp", "qcom,ukee", "qcom,cdp";
	qcom,msm-id = <591 0x10000>;
	qcom,board-id = <1 0>, <0x10001 0>, <0x10001 2>;
};
