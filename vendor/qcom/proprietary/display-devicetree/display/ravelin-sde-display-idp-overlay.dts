/dts-v1/;
/plugin/;

#include "ravelin-sde-display-idp.dtsi"

/ {
	model = "Qualcomm Technologies, Inc. Ravelin IDP";
	compatible = "qcom,ravelin-idp", "qcom,ravelin", "qcom,idp";
	qcom,msm-id = <568 0x10000>, <602 0x10000>;
	qcom,board-id = <34 0>, <34 1>, <34 0x600>, <34 0x601>;
};
