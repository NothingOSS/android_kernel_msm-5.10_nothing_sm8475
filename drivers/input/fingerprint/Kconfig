## drivers/input/fingerprint/Kconfig
```kconfig
config GOODIX_FINGERPRINT
	tristate "generic goodix fingerprint driver"
	default m
	help
	add support for goodix fingerprint driver.
```

## drivers/input/touchscreen/goodix_berlin_driver/Kconfig
```kconfig
#
# Goodix touchscreen driver configuration
#

config TOUCHSCREEN_GOODIX_BRL
	tristate "Goodix berlin touchscreen"
	help
	  Say Y here if you have a Goodix berlin series touch controller
	  to your system.

	  If build module, say M.
	  If unsure, say N.

config TOUCHSCREEN_GOODIX_BRL_SPI
	bool "support SPI bus connection"
	help
	  Say Y here if the touchscreen is connected via SPI bus.
```

## drivers/misc/haptic_hv/Kconfig
```kconfig
#
# Qcom AWINIC_HAPTIC_HV Driver
#

config AWINIC_HAPTIC_HV
	tristate "AWINIC_HAPTIC_HV driver"
	depends on I2C
	help
	  Say Y here if you have Awinic AW869X/AW869XX haptic controller
	  chip in your system.
	  If unsure, say N.
	  To compile this driver as a module, choose M here: the
	  module will be called awinic_haptic_hv.
```

## drivers/nothing_stability/Kconfig
```kconfig
config NOTHING_BOOTLOADER_LOG
	tristate "Nothing bootloader log driver"
	default n
	help
		show booloader_log under proc/bootloader_log

config NOTHING_WRITRBACK_KMSG
	tristate "Nothing kernel writeback driver"
	default n
	help
		The driver logs power-on to system_stage kmsg log.
		So it doesn't log any customer info.
		When the device is stuck. It can help us debug.
		Check the /sys/devices/virtual/NT/NT_reserve_kernel_log/boot_stage_systemserver is exist.

config NOTHING_RESTART_HANDLER
	tristate "Nothing power-off function enhance"
	default n
	help
	  store restart info into imem.

config NOTHING_TASK_MEMINFO
	tristate "Nothing show all task memory info driver"
	default n
	help
		cat /proc/nt_meminfo/show_all_tasks will show all task meminfo

config NOTHING_SECURE_ELEMENT
	tristate "Nothing secure state"
	default n
	help
		This driver getting secure info from hw which setting up in early stage.

config NOTHING_DISK_USAGE
	tristate "Nothing show all file size module"
	default n
	help
		Detect malicious files and prevent them from encroaching on disk space
```

## drivers/nothing_thermal/Kconfig
```kconfig
#
# Generic thermal sysfs drivers configuration
#

config NOTHING_SIMULATED_NTC
	  tristate "Simulatd NTC temp driver"
	  default n
	  help
	    Provide three thermal zones (front, frame and back) to get real shell temp.
```
